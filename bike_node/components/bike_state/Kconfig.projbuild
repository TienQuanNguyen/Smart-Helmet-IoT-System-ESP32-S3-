## bike_node/components/bike_state/Kconfig.projbuild
```kconfig
menu "Bike RFID authorization"
    config BIKE_RFID_UID_SCAN_ONLY
        bool "Read UIDs only (relay always locked)"
        default n
        help
            Print real card UIDs without starting BLE or allowing the relay.

    config BIKE_RFID_UID_1
        string "Authorized card UID 1 (hex, empty denies all)"
        default ""
        help
            Use the real 4, 7 or 10 byte UID printed by rfid_reader.
            Enter hex without spaces, with optional colons between bytes.
            This demo allowlist does not provide cryptographic authentication.

    config BIKE_RFID_UID_2
        string "Authorized card UID 2 (optional)"
        default ""
endmenu
```

## bike_node/sdkconfig.defaults
```kconfig
CONFIG_IDF_TARGET="esp32c3"
CONFIG_LOG_DEFAULT_LEVEL_INFO=y
CONFIG_LOG_MAXIMUM_LEVEL_INFO=y
CONFIG_BT_ENABLED=y
CONFIG_BT_NIMBLE_ENABLED=y
```

## components/wifi_manager/Kconfig.projbuild
```kconfig
menu "Smart Helmet Phase 7 Communication"

    config SMART_HELMET_WIFI_ENABLE
        bool "Enable Wi-Fi station manager"
        default n

    config SMART_HELMET_WIFI_SSID
        string "Wi-Fi SSID"
        default ""
        depends on SMART_HELMET_WIFI_ENABLE

    config SMART_HELMET_WIFI_PASSWORD
        string "Wi-Fi password"
        default ""
        depends on SMART_HELMET_WIFI_ENABLE

    config SMART_HELMET_WIFI_MAX_RETRY
        int "Wi-Fi reconnect retry limit"
        default 5
        range 0 20
        depends on SMART_HELMET_WIFI_ENABLE

    config SMART_HELMET_CLOUD_ENABLE
        bool "Enable emergency HTTP cloud client"
        default n

    config SMART_HELMET_CLOUD_URL
        string "Emergency HTTP/HTTPS endpoint URL"
        default ""
        depends on SMART_HELMET_CLOUD_ENABLE

    config SMART_HELMET_CLOUD_AUTH_TOKEN
        string "Emergency endpoint bearer token"
        default ""
        depends on SMART_HELMET_CLOUD_ENABLE

    config SMART_HELMET_CLOUD_QUEUE_LENGTH
        int "Emergency report queue length"
        default 4
        range 1 16
        depends on SMART_HELMET_CLOUD_ENABLE

    config SMART_HELMET_CLOUD_TIMEOUT_MS
        int "Emergency HTTP request timeout in ms"
        default 5000
        range 1000 30000
        depends on SMART_HELMET_CLOUD_ENABLE

    config SMART_HELMET_BLE_ENABLE
        bool "Enable Helmet/Bike BLE communication contract"
        default n

endmenu
```

## helmet_node/components/helmet_io/Kconfig.projbuild
```kconfig
menu "Helmet IO - confirm hardware before enabling"
config HELMET_SOS_ACTIVE_LEVEL
    int "SOS pressed level (-1 unknown)"
    range -1 1
    default 0
config HELMET_LED_ACTIVE_LEVEL
    int "LED active level (-1 unknown)"
    range -1 1
    default 1
config HELMET_BUZZER_ACTIVE_LEVEL
    int "Buzzer active level (-1 unknown)"
    range -1 1
    default 1
config HELMET_BUZZER_HZ
    int "Buzzer: -1 unknown, 0 active, passive frequency Hz"
    range -1 10000
    default 0
endmenu
```

## helmet_node/components/power_manager/Kconfig.projbuild
```kconfig
menu "Smart Helmet Power Manager"
    config SMART_HELMET_POWER_MOCK
        bool "Enable synthetic battery samples (never real battery data)"
        default n
        help
            Independent of sensor mock mode. No hardware pins are used.
            Default fixture has no verified SOC/capacity: percentage and runtime
            remain unavailable. Real sensing requires a configured board adapter.
    config SMART_HELMET_POWER_TEST
        bool "Run isolated Phase 12 power test instead of normal firmware"
        default n
endmenu
```

## helmet_node/components/wifi_manager/Kconfig.projbuild
```kconfig
menu "Smart Helmet Phase 7 Communication"

    config SMART_HELMET_DEVICE_ID
        string "Device ID for cloud reports"
        default "Helmet_001"

    config SMART_HELMET_WIFI_ENABLE
        bool "Enable Wi-Fi station manager"
        default n

    config SMART_HELMET_WIFI_SSID
        string "Wi-Fi SSID"
        default ""
        depends on SMART_HELMET_WIFI_ENABLE

    config SMART_HELMET_WIFI_PASSWORD
        string "Wi-Fi password"
        default ""
        depends on SMART_HELMET_WIFI_ENABLE

    config SMART_HELMET_WIFI_MAX_RETRY
        int "Wi-Fi reconnect retry limit"
        default 5
        range 0 20
        depends on SMART_HELMET_WIFI_ENABLE

    config SMART_HELMET_CLOUD_ENABLE
        bool "Enable cloud reports and Firebase telemetry"
        default n

    config SMART_HELMET_CLOUD_FIREBASE
        bool "Use Firebase Realtime Database REST API"
        default n
        depends on SMART_HELMET_CLOUD_ENABLE
        help
            PATCH Devices/<device>/telemetry and Events/<device>/<stable ID>.
            Use a database secret, not a Firebase Web API key. Secret is stored
            locally in sdkconfig and compiled firmware. Do not publish either.

    config SMART_HELMET_CLOUD_TELEMETRY_INTERVAL_MS
        int "Firebase telemetry interval (ms)"
        default 5000
        range 1000 60000
        depends on SMART_HELMET_CLOUD_FIREBASE

    config SMART_HELMET_CLOUD_URL
        string "HTTP endpoint or Firebase HTTPS database root"
        default ""
        depends on SMART_HELMET_CLOUD_ENABLE

    config SMART_HELMET_CLOUD_AUTH_TOKEN
        string "Bearer token or Firebase legacy database secret"
        default ""
        depends on SMART_HELMET_CLOUD_ENABLE

    config SMART_HELMET_CLOUD_QUEUE_LENGTH
        int "Emergency report queue length"
        default 4
        range 1 16
        depends on SMART_HELMET_CLOUD_ENABLE

    config SMART_HELMET_CLOUD_TIMEOUT_MS
        int "Emergency HTTP request timeout in ms"
        default 5000
        range 1000 30000
        depends on SMART_HELMET_CLOUD_ENABLE

    config SMART_HELMET_BLE_ENABLE
        bool "Enable Helmet/Bike BLE communication contract"
        default n

endmenu
```

## helmet_node/sdkconfig.defaults
```kconfig
CONFIG_IDF_TARGET="esp32s3"
CONFIG_SMART_HELMET_WIFI_ENABLE=n
CONFIG_SMART_HELMET_CLOUD_ENABLE=y
CONFIG_SMART_HELMET_BLE_ENABLE=y
CONFIG_BT_ENABLED=y
CONFIG_BT_NIMBLE_ENABLED=y
CONFIG_PARTITION_TABLE_SINGLE_APP_LARGE=y
```
